## firmware/boards/arm/nrf52840_smup/nrf52840_smup_defconfig
```kconfig
CONFIG_ARM=y
CONFIG_SOC_FAMILY_NRF=y
CONFIG_SOC_SERIES_NRF52X=y
CONFIG_SOC_NRF52840_QIAA=y
CONFIG_BOARD_NRF52840_SMUP=y

# Enable MPU
CONFIG_ARM_MPU=y

# enable GPIO
CONFIG_GPIO=y

# enable console
CONFIG_CONSOLE=y

# additional board options
CONFIG_GPIO_AS_PINRESET=y
```
